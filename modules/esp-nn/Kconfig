## modules/esp-nn/Kconfig
```kconfig
# Copyright (c) 2023 Meta Platforms
# SPDX-License-Identifier: Apache-2.0

config ZEPHYR_ESP_NN_MODULE
	bool

menuconfig ESP_NN
	bool "ESP-NN Library Support"
	depends on SOC_ESP32C3_FX4
	help
	  This option enables the ESP-NN library.
```

## modules/kissfft/Kconfig
```kconfig
# Copyright (c) 2023 Meta Platforms
# SPDX-License-Identifier: Apache-2.0

config ZEPHYR_KISSFFT_MODULE
	bool

menuconfig KISSFFT
	bool "KissFFT Library Support"
	help
	  This option enables the KissFFT library.
```
